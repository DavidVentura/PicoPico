## esp/Kconfig.projbuild
```kconfig
menu "PicoPico Configuration"
        # GPIO34-39 can only be set as input mode and do not have software-enabled pullup or pulldown functions.
	config WIDTH
		int "SCREEN WIDTH"
		range 0 999
		default 128
		help
			The width resolution of the screen.

	config HEIGHT
		int "SCREEN HEIGHT"
		range 0 999
		default 128
		help
			The height resolution of the screen.

	menu "Controller configuration"
		config GPIO_LEFT
			int "GPIO number for controller LEFT"
			range 0 40
			default 4
			help
				GPIO number (IOxx) to LEFT.
		config GPIO_RIGHT
			int "GPIO number for controller RIGHT"
			range 0 40
			default 15
			help
				GPIO number (IOxx) to RIGHT.
		config GPIO_UP
			int "GPIO number for controller UP"
			range 0 40
			default 0
			help
				GPIO number (IOxx) to UP.
		config GPIO_DOWN
			int "GPIO number for controller DOWN"
			range 0 40
			default 2
			help
				GPIO number (IOxx) to DOWN.
		config GPIO_A
			int "GPIO number for controller A"
			range 0 40
			default 14
			help
				GPIO number (IOxx) to A.
		config GPIO_B
			int "GPIO number for controller B"
			range 0 40
			default 13
			help
				GPIO number (IOxx) to B.
		config GPIO_SELECT
			int "GPIO number for controller SELECT"
			range 0 40
			default 34
			help
				GPIO number (IOxx) to SELECT.
		config GPIO_START
			int "GPIO number for controller START"
			range 0 40
			default 35
			help
				GPIO number (IOxx) to START.
	endmenu

	menu "I2S Audio Configuration"
		config GPIO_AUDIO_BCLK
			int "GPIO number for BCLK"
			range 0 40
			default 26
			help
				GPIO number (IOxx) to BCLK, also called BCK or "bit clock line".
		config GPIO_AUDIO_WS
			int "GPIO number for WS/LRCLK"
			range 0 40
			default 25
			help
				GPIO number (IOxx) to WS/LRCLK.
		config GPIO_AUDIO_DATA_OUT
			int "GPIO number for DATA OUT"
			range 0 40
			default 27
			help
				GPIO number (IOxx) for DATA OUT. Connects to the Audio board on DATA IN. Not on SD, which means SHUTDOWN.
	endmenu

	menu "ST7789 Configuration"

		config OFFSETX
			int "GRAM X OFFSET"
			range 0 99
			default 0
			help
				When your TFT have offset(X), set it.
	
		config OFFSETY
			int "GRAM Y OFFSET"
			range 0 99
			default 0
			help
				When your TFT have offset(Y), set it.
	
		config MOSI_GPIO
			int "MOSI GPIO number"
			range 0 40
			default 18
			help
				GPIO number (IOxx) to SPI MOSI.
				Some GPIOs are used for other purposes (flash connections, etc.) and cannot be used to MOSI.
				On the ESP32, GPIOs 35-39 are input-only so cannot be used as outputs.
				On the ESP32-S2, GPIO 46 is input-only so cannot be used as outputs.
	
		config SCLK_GPIO
			int "SCLK GPIO number"
			range 0 40
			default 5
			help
				GPIO number (IOxx) to SPI SCLK.
				Some GPIOs are used for other purposes (flash connections, etc.) and cannot be used to SCLK.
				On the ESP32, GPIOs 35-39 are input-only so cannot be used as outputs.
				On the ESP32-S2, GPIO 46 is input-only so cannot be used as outputs.
	
		config CS_GPIO
			int "CS GPIO number"
			range -1 40
			default 22
			help
				GPIO number (IOxx) to SPI CS.
				When it is -1, CS isn't performed.
				Some GPIOs are used for other purposes (flash connections, etc.) and cannot be used to CS.
				On the ESP32, GPIOs 35-39 are input-only so cannot be used as outputs.
				On the ESP32-S2, GPIO 46 is input-only so cannot be used as outputs.
	
		config DC_GPIO
			int "DC GPIO number"
			range 0 40
			default 21
			help
				GPIO number (IOxx) to SPI DC.
				Some GPIOs are used for other purposes (flash connections, etc.) and cannot be used to DC.
				On the ESP32, GPIOs 35-39 are input-only so cannot be used as outputs.
				On the ESP32-S2, GPIO 46 is input-only so cannot be used as outputs.
	
		config RESET_GPIO
			int "RESET GPIO number"
			range 0 40
			default 19
			help
				GPIO number (IOxx) to RESET.
				Some GPIOs are used for other purposes (flash connections, etc.) and cannot be used to RESET.
				On the ESP32, GPIOs 35-39 are input-only so cannot be used as outputs.
				On the ESP32-S2, GPIO 46 is input-only so cannot be used as outputs.
	
		config BL_GPIO
			int "BACKLIGHT GPIO number"
			range -1 40
			default 23
			help
				GPIO number (IOxx) to BACKLIGHT.
				When it is -1, BACKLIGHT isn't performed.
				Some GPIOs are used for other purposes (flash connections, etc.) and cannot be used to BACKLIGHT.
				On the ESP32, GPIOs 35-39 are input-only so cannot be used as outputs.
				On the ESP32-S2, GPIO 46 is input-only so cannot be used as outputs.
	
		config INVERSION
			bool "Enable Display Inversion"
			default false
			help
				Enable Display Inversion.
	
	endmenu
endmenu
```
